// SPDX-License-Identifier: GPL-2.0-only OR MIT
/*
 * Copyright (c) 2024 TQ-Systems GmbH <u-boot@ew.tq-group.com>,
 * D-82229 Seefeld, Germany.
 * Author: Matthias Schiffer
 *
 * TQ-Systems EM-CB30 (2GiB RAM variant) - R5 SPL
 */

#include "k3-am625-em-cb30.dts"
#include "k3-am625-em-cb30-u-boot.dtsi"
#include "k3-am62-r5.dtsi"
#include "k3-am62x-r5-em-cb30.dtsi"
#include "k3-am62x-em-cb30-2g-lp4-1600MTs.dtsi"
#include "k3-am62-ddr.dtsi"

/ {
	memory@80000000 {
		/* 2GiB RAM */
		reg = <0x00000000 0x80000000 0x00000000 0x80000000>;
	};
};
