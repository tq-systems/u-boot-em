## board/tqc/em4xx/Kconfig
```kconfig
if TARGET_IMX8MN_EM4XX

config SYS_BOARD
	default "em4xx"

config SYS_VENDOR
	default "tqc"

config SYS_CONFIG_NAME
	default "em4xx"

config DEFAULT_DEVICE_TREE
	default "fsl-imx8mn-em4xx-u"

config DEFAULT_FDT_FILE
	default "imx8mn-em4xx-u.dtb"

config NR_DRAM_BANKS
	default 1

config SYS_TEXT_BASE
	default 0x40200000

config SYS_MALLOC_F_LEN
	default 0x2000

config SAVED_DRAM_TIMING_BASE
	default 0x40000000

config FIT_EXTERNAL_OFFSET
	default 0x3000

config SPL_FIT_GENERATOR
	default "arch/arm/mach-imx/mkimage_fit_atf.sh"

config SYS_EXTRA_OPTIONS
	default "IMX_CONFIG=arch/arm/mach-imx/imx8m/imximage.cfg,SPL_TEXT_BASE=0x912000"

config IMX8MN_EM4XX_DEFAULTS
	bool
	default y
	select ARCH_MISC_INIT
	select TQC_RTC
	select TQC_SDMMC
	select CMD_FUSE
	select BOARD_LATE_INIT
	select BOARD_EARLY_INIT_F
	select FIT
	select OF_CONTROL
	select OF_BOARD_SETUP
	select OF_SYSTEM_SETUP
	select PINCTRL
	select PINCTRL_IMX8M
	select DM
	select DM_RTC
	select DM_MMC
	select MMC_IO_VOLTAGE
	select MMC_HS400_SUPPORT
	select FSL_ESDHC
	select DM_THERMAL
	select DM_SERIAL
	select DM_PMIC
	select MXC_UART
	select DM_GPIO
	select MXC_GPIO
	select DM_I2C
	select SYS_I2C_MXC
	select DM_REGULATOR
	select DM_REGULATOR_FIXED
	select MISC
	select SPL
	select SPL_LOAD_FIT
	select SPL_BOARD_INIT
	select SPL_ENV_SUPPORT
	select SPL_SERIAL_SUPPORT
	select SPL_GPIO_SUPPORT
	select SPL_MMC_SUPPORT
	select SPL_DRIVERS_MISC_SUPPORT
	select SPL_POWER_SUPPORT
	select SPL_I2C_SUPPORT
	select SPL_LIBGENERIC_SUPPORT
	select SPL_LIBCOMMON_SUPPORT
	select ENV_IS_IN_MMC
	select MII
	select CMD_MII
	select CMD_PING
	select CMD_DHCP
	select CMD_NET
	select DM_ETH
	select FEC_MXC
	select PHYLIB
	select PHY_FIXED
	select USB
	select DM_USB
	select USB_EHCI_HCD
	select MXC_USB_OTG_HACTIVE

config IMX8MN_EM4XX_MFG_SUPPORT
	bool "MFG Tool support"
	select USB_GADGET
	select DM_USB_GADGET
	select CI_UDC
	select USB_FUNCTION_SDP
	select USB_FUNCTION_FASTBOOT
	select FASTBOOT_UUU_SUPPORT
	select FASTBOOT_FLASH
	select CMD_FASTBOOT
	select SPL_USB_HOST_SUPPORT
	select SPL_USB_GADGET
	select SPL_USB_SDP_SUPPORT
	select SPL_IMX_ROMAPI_SUPPORT

if IMX8MN_EM4XX_MFG_SUPPORT

config USB_GADGET_MANUFACTURER
	default "FSL"

config USB_GADGET_VENDOR_NUM
	default 0x0525

config USB_GADGET_PRODUCT_NUM
	default 0xa4a5

config USB_GADGET_VBUS_DRAW
	default 2

config SDP_LOADADDR
	default 0x40400000

config FASTBOOT_BUF_ADDR
	default 0x42800000

config SPL_IMX_ROMAPI_LOADADDR
	default 0x48000000 

# restrict to 256M
config FASTBOOT_BUF_SIZE
	default 0x10000000

config FASTBOOT_USB_DEV
	default 0 

endif

source "board/tqc/common/Kconfig"

endif
```

## board/tqs/em300/Kconfig
```kconfig
if TARGET_EM300

config SYS_BOARD
	default "em300"

config SYS_VENDOR
	default "tqs"

config SYS_SOC
	default "mxs"

config SYS_CONFIG_NAME
	default "em300"

endif
```

## board/tqs/em310/Kconfig
```kconfig
if TARGET_EM310

config SYS_BOARD
	default "em310"

config SYS_VENDOR
	default "tqs"

config SYS_SOC
	default "mxs"

config SYS_CONFIG_NAME
	default "em310"

config SYS_MXS_VDD5V_ONLY
	def_bool y

config SPL_MXS_NO_DCDC_BATT_SOURCE
	def_bool y

endif
```

## configs/em300_defconfig
```kconfig
CONFIG_ARM=y
CONFIG_TARGET_EM300=y
CONFIG_SPL_GPIO_SUPPORT=y
CONFIG_SPL_LIBCOMMON_SUPPORT=y
CONFIG_SPL_LIBGENERIC_SUPPORT=y
CONFIG_SPL_SERIAL_SUPPORT=y
CONFIG_SYS_EXTRA_OPTIONS="ENV_IS_IN_MMC"
CONFIG_BOOTDELAY=5
CONFIG_SYS_CONSOLE_IS_IN_ENV=y
CONFIG_VERSION_VARIABLE=y
CONFIG_ARCH_MISC_INIT=y
CONFIG_SPL=y
CONFIG_HUSH_PARSER=y
CONFIG_SYS_PROMPT="> "
CONFIG_AUTOBOOT_KEYED=y
CONFIG_AUTOBOOT_STOP_STR="c"
CONFIG_CMD_CONFIG=y
CONFIG_CMD_BOOTZ=y
CONFIG_CMD_BOOTEFI=y
# CONFIG_CMD_FLASH is not set
# CONFIG_CMD_IMI is not set
# CONFIG_CMD_IMLS is not set
# CONFIG_CMD_XIMG is not set
CONFIG_CMD_MEMTEST=y
CONFIG_CMD_UNZIP=y
CONFIG_CMD_MMC=y
CONFIG_CMD_SPI=y
CONFIG_CMD_I2C=y
CONFIG_CMD_GPIO=y
CONFIG_CMD_DHCP=y
CONFIG_CMD_MII=y
CONFIG_CMD_PING=y
CONFIG_CMD_CACHE=y
CONFIG_CMD_EXT2=y
CONFIG_CMD_EXT4=y
CONFIG_CMD_EXT4_WRITE=y
CONFIG_CMD_FAT=y
CONFIG_CMD_FS_GENERIC=y
CONFIG_MMC_MXS=y
CONFIG_OF_LIBFDT=y
```

## configs/imx8mn_em4xx_cb_defconfig
```kconfig
CONFIG_ARM=y
CONFIG_ARCH_IMX8M=y
CONFIG_TARGET_IMX8MN_EM4XX=y
CONFIG_IMX8MN_EM4XX_MFG_SUPPORT=y
```
