## board/tq/common/Kconfig
```kconfig
config TQ_BDI
	bool

config TQ_ETH
	bool

config TQ_RTC
	bool
	depends on DM_I2C
```

## board/tq/eg4xx/Kconfig
```kconfig
if TARGET_IMX8MN_EG4XX

config SYS_BOARD
	default "eg4xx"

config SYS_VENDOR
	default "tq"

config SYS_CONFIG_NAME
	default "eg4xx"

config DEFAULT_DEVICE_TREE
	default "imx8mn-eg4xx"

config DEFAULT_FDT_FILE
	default "imx8mn-eg4xx.dtb"

config NR_DRAM_BANKS
	default 1

config TEXT_BASE
	default 0x40200000

config SYS_MALLOC_F_LEN
	default 0x2000

config FIT_EXTERNAL_OFFSET
	default 0x3000

config IMX_CONFIG
	default "board/tq/eg4xx/imximage.cfg"

config IMX8MN_EG4XX_HWTYPE
	string "Environment variable 'hwtype'"
	default "eg4xx"
	help
		Environment variable 'hwtype' used for tftp directory in boot_net

choice
	prompt "EG4xx RAM size selection"
	default IMX8MN_EG4XX_MEMORY_512M

config IMX8MN_EG4XX_MEMORY_512M
	bool "512 MiB"
	help
		Select this option if the board has 512 MiB of RAM

endchoice

config IMX8MN_EG4XX_DEFAULTS
	bool
	default y
	select ARCH_MISC_INIT
	select TQ_RTC
	select CMD_FUSE
	select BOARD_LATE_INIT
	select FIT
	select OF_CONTROL
	select OF_BOARD_SETUP
	select OF_SYSTEM_SETUP
	select PINCTRL
	select PINCTRL_IMX8M
	select DM
	select DM_RTC
	select DM_MMC
	select MMC_IO_VOLTAGE
	select MMC_HS400_SUPPORT
	select FSL_ESDHC_IMX
	select DM_THERMAL
	select DM_SERIAL
	select DM_PMIC
	select MXC_UART
	select DM_GPIO
	select MXC_GPIO
	select DM_I2C
	select SYS_I2C_MXC
	select DM_REGULATOR
	select DM_REGULATOR_FIXED
	select MISC
	select SPL
	select SPL_LOAD_FIT
	select SPL_BOARD_INIT
	select SPL_ENV_SUPPORT
	select SPL_SERIAL_SUPPORT
	select SPL_GPIO_SUPPORT
	select SPL_MMC_SUPPORT
	select SPL_DRIVERS_MISC_SUPPORT
	select SPL_POWER_SUPPORT
	select SPL_I2C_SUPPORT
	select SPL_LIBGENERIC_SUPPORT
	select SPL_LIBCOMMON_SUPPORT
	select ENV_IS_IN_MMC
	select MII
	select CMD_MII
	select CMD_PING
	select CMD_DHCP
	select CMD_NET
	select DM_ETH
	select FEC_MXC
	select PHYLIB
	select PHY_FIXED
	select DM_MDIO
	select USB
	select DM_USB
	select USB_EHCI_HCD
	select MXC_USB_OTG_HACTIVE
	select MDIO_GPIO_BITBANG

config IMX8MN_EG4XX_UUU_SUPPORT
	bool "EG4XX UUU SUPPORT"
	select USB_GADGET
	select CI_UDC
	select USB_FUNCTION_SDP
	select USB_FUNCTION_FASTBOOT
	select FASTBOOT_UUU_SUPPORT
	select FASTBOOT_FLASH
	select CMD_FASTBOOT
	select SPL_USB_HOST_SUPPORT
	select SPL_USB_GADGET
	select SPL_IMX_ROMAPI_SUPPORT

if IMX8MN_EG4XX_UUU_SUPPORT

config USB_GADGET_MANUFACTURER
	default "FSL"

config USB_GADGET_VENDOR_NUM
	default 0x0525

config USB_GADGET_PRODUCT_NUM
	default 0xa4a5

config USB_GADGET_VBUS_DRAW
	default 2

config SDP_LOADADDR
	default 0x40400000

config FASTBOOT_BUF_ADDR
	default 0x42800000

config SPL_IMX_ROMAPI_LOADADDR
	default 0x48000000

# restrict to 256M
config FASTBOOT_BUF_SIZE
	default 0x10000000

config FASTBOOT_USB_DEV
	default 0

endif

source "board/tq/common/Kconfig"

endif
```

## board/tq/em-cb30/Kconfig
```kconfig
# SPDX-License-Identifier: GPL-2.0-or-later
#
# Copyright (c) 2024 TQ-Systems GmbH <u-boot@ew.tq-group.com>, D-82229 Seefeld, Germany.
# Author: Matthias Schiffer
#
# Based on AM62x EVM:
#
# Copyright (C) 2020-2022 Texas Instruments Incorporated - https://www.ti.com/
#	Suman Anna <s-anna@ti.com>

choice
	prompt "TQ-Systems EM-CB30 (TI K3 AM62x)"
	optional

config TARGET_AM625_A53_EM_CB30
	bool "EM-CB30 running on A53"
	select ARM64
	select BINMAN

config TARGET_AM625_R5_EM_CB30
	bool "EM-CB30 running on R5"
	select CPU_V7R
	select SYS_THUMB_BUILD
	select K3_LOAD_SYSFW
	select RAM
	select SPL_RAM
	select K3_DDRSS
	select BINMAN
	imply SYS_K3_SPL_ATF

endchoice

if TARGET_AM625_A53_EM_CB30

config SYS_BOARD
       default "em-cb30"

config SYS_VENDOR
       default "tq"

config SYS_CONFIG_NAME
       default "em-cb30"

endif

if TARGET_AM625_R5_EM_CB30

config SYS_BOARD
       default "em-cb30"

config SYS_VENDOR
       default "tq"

config SYS_CONFIG_NAME
       default "em-cb30"

config SPL_LDSCRIPT
	default "arch/arm/mach-omap2/u-boot-spl.lds"

endif
```

## board/tq/em310/Kconfig
```kconfig
if TARGET_EM310

config SYS_BOARD
	default "em310"

config SYS_VENDOR
	default "tq"

config SYS_SOC
	default "mxs"

config SYS_CONFIG_NAME
	default "em310"

config SYS_MXS_VDD5V_ONLY
	def_bool y

config EM310_DEFAULTS
	bool
	default y
	select TQ_BOARDGPIO
	select TQ_RTC
	select BOARD_LATE_INIT
	select BOARD_EARLY_INIT_F

source "board/tq/common/Kconfig"

endif
```

## configs/em310_defconfig
```kconfig
CONFIG_ARM=y
CONFIG_ARCH_MX28=y
CONFIG_TEXT_BASE=0x40002000
CONFIG_SYS_MALLOC_F_LEN=0x400
CONFIG_SPL_GPIO=y
CONFIG_SPL_LIBCOMMON_SUPPORT=y
CONFIG_SPL_LIBGENERIC_SUPPORT=y
CONFIG_NR_DRAM_BANKS=1
CONFIG_ENV_SIZE=0x40000
CONFIG_ENV_OFFSET=0x800
CONFIG_IMX_CONFIG=""
CONFIG_DM_GPIO=y
CONFIG_DEFAULT_DEVICE_TREE="imx28-em310"
CONFIG_SPL_TEXT_BASE=0x00001000
CONFIG_TARGET_EM310=y
CONFIG_SPL_SERIAL=y
CONFIG_SPL=y
CONFIG_ENV_OFFSET_REDUND=0x41000
CONFIG_SYS_LOAD_ADDR=0x42000000
CONFIG_BUILD_TARGET="u-boot.sb"
CONFIG_TIMESTAMP=y
CONFIG_FIT=y
CONFIG_BOOTDELAY=-2
CONFIG_AUTOBOOT_KEYED=y
CONFIG_AUTOBOOT_STOP_STR="c"
CONFIG_OF_BOARD_SETUP=y
CONFIG_USE_BOOTCOMMAND=y
CONFIG_BOOTCOMMAND="run set_bootsys; mmc dev ${mmcdev} ${mmcpart}; if mmc rescan; then echo Found mmc device; run boot_mmc; else echo No mmc device found, run netconsole; run args_nc; fi"
CONFIG_SYS_CONSOLE_IS_IN_ENV=y
CONFIG_ARCH_MISC_INIT=y
CONFIG_MISC_INIT_R=y
# CONFIG_SPL_FRAMEWORK is not set
CONFIG_SPL_NO_BSS_LIMIT=y
CONFIG_HUSH_PARSER=y
CONFIG_SYS_PROMPT="> "
CONFIG_CMD_CONFIG=y
CONFIG_CMD_BOOTZ=y
# CONFIG_CMD_IMI is not set
# CONFIG_CMD_XIMG is not set
CONFIG_CMD_MEMTEST=y
CONFIG_CMD_LZMADEC=y
CONFIG_CMD_UNLZ4=y
CONFIG_CMD_UNZIP=y
CONFIG_CMD_DM=y
CONFIG_CMD_GPIO=y
CONFIG_CMD_I2C=y
CONFIG_CMD_MMC=y
CONFIG_CMD_DHCP=y
CONFIG_CMD_MII=y
CONFIG_CMD_PING=y
CONFIG_CMD_CACHE=y
CONFIG_CMD_EXT2=y
CONFIG_CMD_EXT4=y
CONFIG_CMD_EXT4_WRITE=y
CONFIG_CMD_FAT=y
CONFIG_CMD_FS_GENERIC=y
CONFIG_OF_CONTROL=y
CONFIG_SPL_OF_CONTROL=y
CONFIG_OF_SPL_REMOVE_PROPS=""
CONFIG_ENV_OVERWRITE=y
CONFIG_ENV_IS_IN_MMC=y
CONFIG_SYS_REDUNDAND_ENVIRONMENT=y
CONFIG_SYS_RELOC_GD_ENV_ADDR=y
CONFIG_USE_BOOTFILE=y
CONFIG_BOOTFILE="zImage"
CONFIG_VERSION_VARIABLE=y
CONFIG_NETCONSOLE=y
CONFIG_USE_IPADDR=y
CONFIG_IPADDR="192.168.9.100"
CONFIG_USE_NETMASK=y
CONFIG_NETMASK="255.255.255.0"
CONFIG_USE_SERVERIP=y
CONFIG_SERVERIP="192.168.9.133"
CONFIG_SPL_DM=y
CONFIG_DEVRES=y
CONFIG_SPL_OF_TRANSLATE=y
CONFIG_MXS_GPIO=y
CONFIG_DM_I2C=y
# CONFIG_SPL_DM_I2C is not set
CONFIG_I2C_SET_DEFAULT_BUS_NUM=y
CONFIG_DM_I2C_GPIO=y
# CONFIG_SPL_DM_I2C_GPIO is not set
CONFIG_LED=y
CONFIG_LED_GPIO=y
CONFIG_SUPPORT_EMMC_BOOT=y
CONFIG_MMC_MXS=y
CONFIG_PHYLIB=y
CONFIG_PHY_MICREL=y
CONFIG_PHY_MICREL_KSZ8XXX=y
CONFIG_PHY_FIXED=y
CONFIG_PHY_RESET_DELAY=10000
CONFIG_DM_MDIO=y
CONFIG_DM_DSA=y
CONFIG_DM_ETH_PHY=y
CONFIG_FEC_MXC=y
CONFIG_MII=y
CONFIG_RMII=y
CONFIG_PINCTRL=y
CONFIG_PINCTRL_MXS=y
CONFIG_DM_REGULATOR=y
CONFIG_DM_REGULATOR_FIXED=y
CONFIG_DM_REGULATOR_GPIO=y
CONFIG_CONS_INDEX=0
CONFIG_PL011_SERIAL=y
```

## configs/imx8mn_em4xx_cb_1g_defconfig
```kconfig
CONFIG_ARM=y
CONFIG_ARCH_IMX8M=y
CONFIG_SYS_MALLOC_LEN=0x2000000
CONFIG_SYS_MALLOC_F_LEN=0x10000
CONFIG_SPL_GPIO=y
CONFIG_ENV_SIZE=0x4000
CONFIG_ENV_OFFSET=0x400000
CONFIG_SPL_TEXT_BASE=0x912000
CONFIG_TARGET_IMX8MN_EM4XX=y
CONFIG_IMX8MN_EM4XX_UUU_SUPPORT=y
CONFIG_SYS_MONITOR_LEN=524288
CONFIG_SPL_MMC=y
CONFIG_SPL_SERIAL=y
CONFIG_SPL_DRIVERS_MISC=y
CONFIG_SPL_STACK=0x980000
CONFIG_SPL_SYS_MALLOC_F_LEN=0x2000
CONFIG_SPL_SIZE_LIMIT=0x34000
CONFIG_ENV_OFFSET_REDUND=0x404000
CONFIG_IMX_BOOTAUX=y
CONFIG_SYS_LOAD_ADDR=0x40480000
CONFIG_SYS_MEMTEST_START=0x40480000
CONFIG_SYS_MEMTEST_END=0x58480000
CONFIG_SYS_BOOT_GET_CMDLINE=y
CONFIG_SYS_BARGSIZE=2048
CONFIG_REMAKE_ELF=y
CONFIG_DISTRO_DEFAULTS=y
CONFIG_BOOTDELAY=-2
CONFIG_BOOTCOMMAND="run serialconsole; run set_bootsys; run mmcboot; run netconsole"
CONFIG_SPL_MAX_SIZE=0x25000
CONFIG_SPL_HAS_BSS_LINKER_SECTION=y
CONFIG_SPL_BSS_START_ADDR=0x95e000
CONFIG_SPL_BSS_MAX_SIZE=0x2000
CONFIG_SPL_BOOTROM_SUPPORT=y
CONFIG_SPL_LEGACY_IMAGE_FORMAT=y
CONFIG_SPL_LEGACY_IMAGE_CRC_CHECK=y
# CONFIG_SPL_SHARES_INIT_SP_ADDR is not set
CONFIG_SPL_SYS_MALLOC=y
CONFIG_SPL_HAS_CUSTOM_MALLOC_START=y
CONFIG_SPL_CUSTOM_SYS_MALLOC_ADDR=0x42200000
CONFIG_SPL_SYS_MALLOC_SIZE=0x80000
CONFIG_SYS_MMCSD_RAW_MODE_U_BOOT_USE_SECTOR=y
CONFIG_SYS_MMCSD_RAW_MODE_U_BOOT_SECTOR=0x300
# CONFIG_SPL_CRYPTO is not set
CONFIG_SPL_I2C=y
CONFIG_SPL_POWER=y
CONFIG_SPL_WATCHDOG=y
CONFIG_SYS_PROMPT="u-boot=> "
CONFIG_SYS_MAXARGS=64
CONFIG_SYS_CBSIZE=2048
CONFIG_SYS_PBSIZE=2074
CONFIG_CMD_LICENSE=y
# CONFIG_BOOTM_NETBSD is not set
# CONFIG_CMD_EXPORTENV is not set
# CONFIG_CMD_IMPORTENV is not set
CONFIG_CMD_GREPENV=y
CONFIG_CRC32_VERIFY=y
CONFIG_CMD_MD5SUM=y
CONFIG_MD5SUM_VERIFY=y
CONFIG_CMD_MEMINFO=y
CONFIG_CMD_MEMTEST=y
CONFIG_SYS_ALT_MEMTEST=y
CONFIG_CMD_CLK=y
CONFIG_CMD_GPIO=y
CONFIG_CMD_I2C=y
CONFIG_CMD_MMC=y
CONFIG_CMD_READ=y
CONFIG_CMD_USB=y
CONFIG_CMD_CACHE=y
CONFIG_CMD_TIME=y
# CONFIG_CMD_HASH is not set
# CONFIG_SPL_EFI_PARTITION is not set
CONFIG_SPL_OF_CONTROL=y
CONFIG_OF_LIST="imx8mn-em4xx-u imx8mn-em4xx-l"
CONFIG_ENV_OVERWRITE=y
CONFIG_SYS_REDUNDAND_ENVIRONMENT=y
CONFIG_ENV_VARS_UBOOT_RUNTIME_CONFIG=y
CONFIG_VERSION_VARIABLE=y
CONFIG_NET_RANDOM_ETHADDR=y
CONFIG_NETCONSOLE=y
CONFIG_USE_IPADDR=y
CONFIG_IPADDR="192.168.9.100"
CONFIG_USE_NETMASK=y
CONFIG_NETMASK="255.255.255.0"
CONFIG_USE_SERVERIP=y
CONFIG_SERVERIP="192.168.9.133"
CONFIG_SPL_DM=y
CONFIG_REGMAP=y
CONFIG_SYSCON=y
CONFIG_CLK_IMX8MN=y
CONFIG_FSL_CAAM=y
CONFIG_FASTBOOT_FLASH_MMC_DEV=0
CONFIG_SPL_FIRMWARE=y
CONFIG_DM_PCA953X=y
CONFIG_LED=y
CONFIG_LED_GPIO=y
# CONFIG_SPL_MISC is not set
CONFIG_SUPPORT_EMMC_BOOT=y
CONFIG_SPL_MMC_IO_VOLTAGE=y
CONFIG_MMC_UHS_SUPPORT=y
CONFIG_FSL_USDHC=y
CONFIG_PHY_MICREL=y
CONFIG_PHY_MICREL_KSZ8XXX=y
CONFIG_PHY_TI=y
CONFIG_PHY_RESET_DELAY=100
CONFIG_DM_MDIO=y
CONFIG_DM_ETH_PHY=y
CONFIG_RMII=y
CONFIG_PINCONF=y
CONFIG_SPL_PINCTRL=y
CONFIG_DM_PMIC_PCA9450=y
CONFIG_SPL_DM_PMIC_PCA9450=y
CONFIG_SPECIFY_CONSOLE_INDEX=y
# CONFIG_SPL_DM_USB is not set
CONFIG_IMX_WATCHDOG=y
CONFIG_WDT=y
CONFIG_EXT4_WRITE=y
# CONFIG_SPL_SHA1 is not set
# CONFIG_SPL_SHA_HW_ACCEL is not set
# CONFIG_EFI_LOADER is not set
```
